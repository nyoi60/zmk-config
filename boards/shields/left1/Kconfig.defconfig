## boards/shields/left1/Kconfig.defconfig
```kconfig
if SHIELD_LEFT1_LEFT

config ZMK_KEYBOARD_NAME
    default "left"

config ZMK_SPLIT_ROLE_CENTRAL
    default y

endif # SHIELD_LEFT1_LEFT

if SHIELD_LEFT1_LEFT || SHIELD_LEFT1_RIGHT

config ZMK_SPLIT
    default y

endif # SHIELD_LEFT1_LEFT || SHIELD_LEFT1_RIGHT
```

## boards/shields/left1/Kconfig.shield
```kconfig
config SHIELD_LEFT1_LEFT
    def_bool $(shields_list_contains,left1_left)

config SHIELD_LEFT1_RIGHT
    def_bool $(shields_list_contains,left1_right)
```
